## canutils/libcanardv1/Kconfig
```kconfig
#
# For a description of the syntax of this configuration file,
# see the file kconfig-language.txt in the NuttX tools repository.
#

config CANUTILS_LIBCANARDV1
	bool "libcanard UAVCAN v1 Library"
	default n
	depends on NET_CAN
	---help---
		Enable the libcanard UAVCAN v1 library.

if CANUTILS_LIBCANARDV1

config LIBCANARDV1_URL
	string "libcanard URL"
	default "https://github.com/UAVCAN/libcanard/archive"
	---help---
		libcanard URL.

config LIBCANARDV1_VERSION
	string "libcanard Version"
	default "cde670347425023480a1417fcd603b27c8eb06c1"
	---help---
		libcanard version.

endif
```

## myapp1/Kconfig
```kconfig
#
# For a description of the syntax of this configuration file,
# see the file kconfig-language.txt in the NuttX tools repository.
#

config MY_APP1
	tristate "my app1"
	default n
	---help---
		Enable the my app1
```

## myapp2/Kconfig
```kconfig
#
# For a description of the syntax of this configuration file,
# see the file kconfig-language.txt in the NuttX tools repository.
#

config MY_APP2
	tristate "my app2"
	default n
	---help---
		Enable the my app2

if MY_APP2

config MY_APP2_PROGNAME
	string "Program name"
	default "myapp2"
	---help---
		This is the name of the program that will be used when the NSH ELF
		program is installed.

config MY_APP2_PRIORITY
	int "Hello task priority"
	default 100

config MY_APP2_STACKSIZE
	int "Hello stack size"
	default DEFAULT_TASK_STACKSIZE

endif
```

## myled/Kconfig
```kconfig
#
# For a description of the syntax of this configuration file,
# see the file kconfig-language.txt in the NuttX tools repository.
#

config MY_LED
	tristate "my led"
	default n
	---help---
		Enable the my led
```

## mytest/Kconfig
```kconfig
#
# For a description of the syntax of this configuration file,
# see the file kconfig-language.txt in the NuttX tools repository.
#

config MY_TEST
	tristate "my test"
	default n
	---help---
		Enable the my test
```
